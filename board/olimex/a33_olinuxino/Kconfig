## board/olimex/a33_olinuxino/Kconfig
```kconfig
if TARGET_A33_OLINUXINO

config SYS_BOARD
	default "a33_olinuxino"

config SYS_VENDOR
	default "olimex"

config SYS_CONFIG_NAME
	default "a33_olinuxino"

endif
```

## configs/A20-OLinuXino_defconfig
```kconfig
CONFIG_ARM=y
CONFIG_ARCH_SUNXI=y
CONFIG_SPL=y
CONFIG_MACH_SUN7I=y
CONFIG_DRAM_CLK=384
CONFIG_DEFAULT_DEVICE_TREE="sun7i-a20-olinuxino"
CONFIG_AHCI=y
# CONFIG_SYS_MALLOC_CLEAR_ON_INIT is not set
CONFIG_SPL_I2C_SUPPORT=y
CONFIG_CMD_DFU=y
# CONFIG_CMD_FLASH is not set
CONFIG_CMD_USB_MASS_STORAGE=y
# CONFIG_SPL_DOS_PARTITION is not set
# CONFIG_SPL_PARTITION_UUIDS is not set

CONFIG_CMD_SF=y
CONFIG_CMD_SF_TEST=y

CONFIG_DM_SPI_FLASH=y
CONFIG_SPI_FLASH=y
CONFIG_SPI_FLASH_WINBOND=y
CONFIG_SPL_SPI_SUNXI=y

CONFIG_SPI=y
CONFIG_DM_SPI=y
CONFIG_SUN4I_SPI=y

# CONFIG_ENV_IS_IN_FAT is not set

CONFIG_DM_MMC=y
CONFIG_SCSI_AHCI=y
CONFIG_DFU_RAM=y
CONFIG_FASTBOOT_CMD_OEM_FORMAT=y
CONFIG_ETH_DESIGNWARE=y
CONFIG_RGMII=y
CONFIG_SUN7I_GMAC=y
CONFIG_PHY_SMSC=y
CONFIG_PHY_REALTEK=y
CONFIG_PHY_MICREL=y
CONFIG_PHY_MICREL_KSZ90X1=y
CONFIG_AXP_ALDO3_VOLT=2800
CONFIG_AXP_ALDO4_VOLT=2800
CONFIG_SCSI=y
CONFIG_USB_EHCI_HCD=y
CONFIG_USB_MUSB_GADGET=y
CONFIG_SYS_USB_EVENT_POLL_VIA_INT_QUEUE=y
CONFIG_TARGET_A20_OLINUXINO=y
CONFIG_OF_LIBFDT_OVERLAY=y
CONFIG_FIT=y
CONFIG_OF_BOARD_FIXUP=y
CONFIG_OF_SYSTEM_SETUP=y

CONFIG_OF_LIST="sun7i-a20-olinuxino-micro sun7i-a20-olinuxino-micro-emmc sun7i-a20-olinuxino-lime sun7i-a20-olinuxino-lime-emmc"
CONFIG_MULTI_DTB_FIT=y
```
